## app/drivers/led_sensor/Kconfig
```kconfig
config LED_SENSOR
	bool "LED Sensor Driver"
	depends on GPIO && SENSOR
	help
	  Enable the LED-based sensor driver. sample_fetch turns the LED on;
	  channel_get reports the state and turns the LED off.
```

## boards/jjateen/iomico_scratch/Kconfig.iomico_scratch
```kconfig
# SPDX-License-Identifier: Apache-2.0

config BOARD_IOMICO_SCRATCH
	select SOC_NRF52840_QIAA
```

## boards/jjateen/iomico_scratch/board.yml
```yaml
board:
  name: iomico_scratch
  full_name: Iomico Scratch (nRF52840)
  vendor: jjateen
  socs:
  - name: nrf52840
```

## boards/jjateen/jj_xiao_sense/Kconfig.defconfig
```kconfig
# JJ XIAO Sense board configuration
# SPDX-License-Identifier: Apache-2.0

if BOARD_JJ_XIAO_SENSE

source "boards/common/usb/Kconfig.cdc_acm_serial.defconfig"

endif # BOARD_JJ_XIAO_SENSE
```

## boards/jjateen/jj_xiao_sense/Kconfig.jj_xiao_sense
```kconfig
# JJ XIAO Sense board configuration
# SPDX-License-Identifier: Apache-2.0

config BOARD_JJ_XIAO_SENSE
	select SOC_NRF52840_QIAA
```

## boards/jjateen/jj_xiao_sense/board.yml
```yaml
board:
  name: jj_xiao_sense
  full_name: JJ XIAO Sense (nRF52840)
  vendor: jjateen
  socs:
  - name: nrf52840
```
